## configs/fairlady_defconfig
```kconfig
# Source XNU configuration for OnePlus 15T (fairlady) early bring-up
CONFIG_XNU_BUILD_ARCHIVES=y
CONFIG_XNU_SOURCE_CORECRYPTO14=y
CONFIG_XNU_SOURCE_PTHREAD=y
CONFIG_XNU_ARM_DT_PLATFORM=y
CONFIG_XNU_ARMCPU=y
CONFIG_XNU_NATIVE_ARCH_TIMER=y
CONFIG_XNU_DT_PANIC_REGION=y
CONFIG_XNU_CRYPTO_BOOTSTRAP="source"
# CONFIG_XNU_ARMVIRT_PLATFORM is not set
# CONFIG_XNU_NATIVE_UFS is not set
# CONFIG_XNU_NATIVE_AES is not set
# CONFIG_XNU_NATIVE_ADRENO is not set
CONFIG_XNU_BOOT_PROGRESS=y
CONFIG_XNU_EARLY_BOOT_PROGRESS=y
```
